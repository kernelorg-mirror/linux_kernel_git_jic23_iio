## Documentation/devicetree/bindings/iio/potentiometer/adi,ad5246-005.yaml
```yaml
# SPDX-License-Identifier: (GPL-2.0-only OR BSD-2-Clause)
%YAML 1.2
---
$id: http://devicetree.org/schemas/iio/potentiometer/adi,ad5246-005.yaml#
$schema: http://devicetree.org/meta-schemas/core.yaml#

title: Analog Devices AD5246 digital rheostat

maintainers:
  - Joseph Telaak <joseph@telaak.dev>

description: |
  128-position digital rheostat with an I2C interface. The compatible
  names the end-to-end resistance in kOhm.

  Datasheet: https://www.analog.com/en/products/ad5246.html

properties:
  compatible:
    enum:
      - adi,ad5246-005
      - adi,ad5246-010
      - adi,ad5246-050
      - adi,ad5246-100

  reg:
    maxItems: 1

  vdd-supply: true

  "#io-channel-cells":
    const: 0

required:
  - compatible
  - reg
  - vdd-supply

additionalProperties: false

examples:
  - |
    i2c {
        #address-cells = <1>;
        #size-cells = <0>;

        potentiometer@2e {
            compatible = "adi,ad5246-010";
            reg = <0x2e>;
            vdd-supply = <&reg_3v3>;
            #io-channel-cells = <0>;
        };
    };
...
```
